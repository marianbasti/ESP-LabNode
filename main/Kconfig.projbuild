## main/Kconfig.projbuild
```kconfig
menu "Example Configuration"

    config EXAMPLE_SCAN_LIST_SIZE
        int "Max size of scan list"
        range 0 20
        default 10
        help
            The size of array that will be used to retrieve the list of access points.

    config EXAMPLE_USE_SCAN_CHANNEL_BITMAP
        bool "Scan only non overlapping channels using Channel bitmap"
        default 0
        help
            Enable this to scan only the non overlapping channels i.e 1,6,11 by mentioning a channel bitmap
            in scan config. If you wish to scan a different set of specific channels, please edit the channel_list
            array in scan.c. Channels for a 2.4 ghz network range should range from 1-14.
endmenu

menu "Temperature Control Configuration"

    config GPIO_DHT
        int "DHT GPIO Number"
        range 0 48
        default 4
        help
            GPIO number for DHT22 sensor.

    config GPIO_RELAY
        int "Relay GPIO Number"
        range 0 48
        default 3
        help
            GPIO number for relay control.

    config GPIO_LED
        int "Status LED GPIO Number"
        range 0 48
        default 2
        help
            GPIO number for status LED.

    config WIFI_SSID
        string "WiFi SSID"
        default "myssid"
        help
            SSID (network name) to connect to.

    config WIFI_PASSWORD
        string "WiFi Password"
        default "mypassword"
        help
            WiFi password (WPA or WPA2) to connect to.

    config HOSTNAME_MAX_LENGTH
        int "Maximum hostname length"
        range 1 32
        default 32
        help
            Maximum length for device hostname.

endmenu
```
